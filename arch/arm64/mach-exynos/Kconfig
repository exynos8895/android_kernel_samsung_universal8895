## arch/arm64/mach-exynos/Kconfig
```kconfig
# arch/arm64/mach-exynos/Kconfig
#
# Copyright (c) 2016 Samsung Electronics Co., Ltd.
#		http://www.samsung.com/
#
# Licensed under GPLv2

# Configuration options for the EXYNOS8

if ARCH_EXYNOS

menu "SAMSUNG EXYNOS SoCs Support"

config SKIP_HW_BREAKPOINT
	bool "support skip hw breakpoint"
	default n
	help
	  Support early param for T32 onchip breakpoint

choice
	prompt "Exynos device target"
	default MACH_EXYNOS8895_NONE

config MACH_EXYNOS8895_NONE
	bool "None"

config MACH_EXYNOS8895_DREAMLTE_EUR_OPEN
	bool "Galaxy S8 (SM-G950F)"
	select EXYNOS_DTBTOOL

config MACH_EXYNOS8895_DREAM2LTE_EUR_OPEN
	bool "Galaxy S8+ (SM-G955F)"
	select EXYNOS_DTBTOOL

config MACH_EXYNOS8895_GREATLTE_EUR_OPEN
	bool "Galaxy Note8 (SM-N950F)"
	select EXYNOS_DTBTOOL

config MACH_EXYNOS8895_DREAMLTE_KOR
	bool "Galaxy S8 (SM-G950N)"
	select EXYNOS_DTBTOOL

config MACH_EXYNOS8895_DREAM2LTE_KOR
	bool "Galaxy S8+ (SM-G955N)"
	select EXYNOS_DTBTOOL

config MACH_EXYNOS8895_GREATLTE_KOR
	bool "Galaxy Note8 (SM-N950N)"
	select EXYNOS_DTBTOOL

endchoice

endmenu

endif
```
